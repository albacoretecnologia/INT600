## sources/meta-albacore/conf/layer.conf
```bitbake
# We have a conf and classes directory, add to BBPATH
BBPATH =. "${LAYERDIR}:"

# We have recipes-* directories, add to BBFILES
BBFILES += "${LAYERDIR}/recipes-*/*/*.bb \
	${LAYERDIR}/recipes-*/*/*.bbappend"

BBFILE_COLLECTIONS += "albacore"
BBFILE_PATTERN_albacore = "^${LAYERDIR}/"
BBFILE_PRIORITY_albacore = "10"
```

## sources/meta-albacore/conf/machine/ccimx6sbc.conf
```bitbake
#@TYPE: Machine
#@NAME: ConnectCore 6 Single Board Computer.
#@DESCRIPTION: Machine configuration for Digi's ConnectCore 6 SBC.

# disable some DIGI recipes not compatible with mainline kernel
BBMASK += " \
	meta-digi-dey/recipes-graphics/mesa/ \
	meta-digi-dey/recipes-graphics/drm/ \
	meta-digi-dey/recipes-qt/qt5/ \
	meta-digi-dey/recipes-graphics/imx-gpu-viv \
	meta-digi-dey/recipes-multimedia/gstreamer \
	"

# use mainline kernel
MACHINEOVERRIDES_append = ":use-mainline-bsp"

# use correct defconfig from mainline kernel
KERNEL_DEFCONFIG ?= "arch/arm/configs/imx_v6_v7_defconfig"

# Contains the ConnectCore 6 module.
include conf/machine/include/ccimx6.inc

# set MACHINEOVERRIDES_EXTENDER to disable VIVANTE GPU options
MACHINEOVERRIDES_EXTENDER_mx6q = "imxipu:imxvpu:imxvpucnm:imxdpublit"
MACHINEOVERRIDES_EXTENDER_mx6dl = "imxipu:imxvpu:imxvpucnm:imxdpublit"
MACHINE_SOCARCH_FILTER_append = " virtual/libopenvg virtual/libgles1 virtual/libgles2 virtual/egl virtual/mesa virtual/libgl virtual/libg2d cairo pango"

# Firmware
MACHINE_FIRMWARE_append = " ${@base_conditional('HAVE_BT', '1' , 'firmware-atheros-ar3k', '', d)}"
MACHINE_FIRMWARE_append = " ${@base_conditional('HAVE_WIFI', '1' , 'firmware-atheros-ath6kl', '', d)}"

# U-Boot configurations
# Last one is the default (the one the symlinks point at)
UBOOT_CONFIG ??= "ccimx6dlsbc512MB ccimx6dlsbc ccimx6qsbc2GB ccimx6qsbc512MB ccimx6qsbc"
UBOOT_CONFIG[ccimx6dlsbc512MB] = "ccimx6dlsbc512MB_defconfig,,u-boot-dtb.${UBOOT_SUFFIX}"
UBOOT_CONFIG[ccimx6dlsbc] = "ccimx6dlsbc_defconfig,,u-boot-dtb.${UBOOT_SUFFIX}"
UBOOT_CONFIG[ccimx6qsbc2GB] = "ccimx6qsbc2GB_defconfig,,u-boot-dtb.${UBOOT_SUFFIX}"
UBOOT_CONFIG[ccimx6qsbc512MB] = "ccimx6qsbc512MB_defconfig,,u-boot-dtb.${UBOOT_SUFFIX}"
UBOOT_CONFIG[ccimx6qsbc] = "ccimx6qsbc_defconfig,,u-boot-dtb.${UBOOT_SUFFIX}"

# mesa is prefered OpenGL implementation
PREFERRED_PROVIDER_virtual/mesa_mx6q = "mesa"
PREFERRED_PROVIDER_virtual/egl_mx6q = "mesa"
PREFERRED_PROVIDER_virtual/libgl_mx6q = "mesa"
PREFERRED_PROVIDER_virtual/libgles1_mx6q = "mesa"
PREFERRED_PROVIDER_virtual/libgles2_mx6q = "mesa"

# preferred gstreamer1.0-plugins-bad implementation is from NXP
PREFERRED_VERSION_gstreamer1.0-plugins-bad = "1.12.imx"

# set device tree
KERNEL_DEVICETREE ?= "imx6q-ccimx6sbc.dtb"

# set consoles
SERIAL_CONSOLES ?= "115200;ttymxc3"

# Bluetooth tty
BT_TTY ?= "ttymxc1"

# U-Boot script to be copied to the boot image
BOOT_SCRIPTS = "boot.scr:boot.scr"

# Flash image types
IMAGE_FSTYPES ?= "boot.vfat ext4 sdcard tar.bz2 recovery.vfat"

# disable X11/wayland and enable OpenGL
DISTRO_FEATURES_append = " opengl"
DISTRO_FEATURES_remove = "x11 wayland"

# disable broken packages
MACHINE_EXTRA_RRECOMMENDS_remove = "imx-alsa-plugins cryptodev-module"
```
